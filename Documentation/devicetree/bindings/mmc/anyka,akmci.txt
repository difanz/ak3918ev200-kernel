## drivers/media/video/plat-anyka/Kconfig
```kconfig
config SENSOR_GC0308
	tristate "gc0308 sensor support"
	depends on LINUX_AKSENSOR
	help
	  This is a gc0308 sensor driver
	  
config SENSOR_OV2643
	tristate "ov2643 sensor support"
	depends on LINUX_AKSENSOR
	help
	  This is a ov2643 sensor driver
	  
config SENSOR_OV7725
	tristate "ov7725 sensor support"
	depends on LINUX_AKSENSOR
	help
	  This is a ov7725 sensor driver
	  
config SENSOR_HM1375
	tristate "hm1375 sensor support"
	depends on LINUX_AKSENSOR
	help
	  This is a hm1375 sensor driver
	  
config SENSOR_OV9712
	tristate "ov9712 sensor support"
	depends on LINUX_AKSENSOR
	help
	  This is a ov9712 sensor driver
	  
config SENSOR_OV2710
	tristate "ov2710 sensor support"
	depends on LINUX_AKSENSOR
	help
	  This is a ov2710 sensor driver

config SENSOR_AR0130
	tristate "ar0130 sensor support"
	depends on LINUX_AKSENSOR
	help
	  This is a ar0130 sensor driver

config SENSOR_H22
	tristate "jx-h22 sensor support"
	depends on LINUX_AKSENSOR
	help
	  This is a jx-h22 sensor driver

config SENSOR_NT99141
	tristate "nt99141 sensor support"
	depends on LINUX_AKSENSOR
	help
	  This is a nt99141 sensor driver

config AK_ISP_CORE
	bool "Anyka ISP core, built from source"
	depends on ARCH_AK39
	help
	  The ak_isp_* implementation behind /dev/isp_char. Anyka ships this as
	  a prebuilt libispdrv.a per SoC; this builds it from the SDK sources
	  instead, adapted for this part.

	  The EV200 register-block sizes, word indices, SDB upload-enable bits in
	  REG5[32] and isp_working_mode numbering are applied and checked against
	  this unit's stock kernel. The port is still not finished: the 3A edits
	  are unapplied, the LUT blocks are unverified, and none of it has run on
	  hardware.

	  Depends on BROKEN so it cannot be enabled by accident. See
	  notes/isp-port.md for the remaining list.

	  If unsure, say N.
```
