## Documentation/devicetree/bindings/mmc/anyka,akmci.txt
```
* Anyka AK39 MCI host controller

The MCI block is the MMC/SD/SDIO host controller on the Anyka AK39 family
(AK3918EV200, AK39EV330). It is PL180-inspired but not PL180-compatible: the
register roles at 0x038, 0x03c and 0x040 differ, the status bits are
renumbered, status is cleared by being read, and payload reaches the card
through one 512-byte buffer taken from the SoC's shared L2 pool rather than
through an internal FIFO. Do not describe it as "arm,pl18x".

Required properties:
- compatible	: should be one of
		    "anyka,ak3918ev200-mmc0"	MMC/SD instance
		    "anyka,ak3918ev200-mmc1"	SDIO instance
		    "anyka,ak39ev330-mmc0"	MMC/SD instance
		    "anyka,ak39ev330-mmc1"	SDIO instance
		  A board may list the SoC-specific string first and the
		  family string second.
- reg		: controller register block
- interrupts	: the controller interrupt; the shared L2 interrupt may
		  follow it and is not claimed by this driver
- clocks	: the controller gate clock

Optional properties, in addition to the common MMC bindings described in
mmc.txt:
- bus-width	: 1 or 4. Defaults to 4. Boards that route only DAT0 must
		  say 1; a wider setting on such a board corrupts transfers.
- max-frequency	: bus clock ceiling in Hz. Defaults to 25000000.
- broken-cd	: the card detect pad is not usable; the slot is treated as
		  always occupied even when cd-gpios is present.
- non-removable	: the card is soldered or otherwise never swapped.
- cd-gpios	: card detect GPIO, active low. Ignored when broken-cd is set.
- wp-gpios	: write protect GPIO, active low.
- cap-sd-highspeed, cap-mmc-highspeed : enable high-speed timing.

Example:

	mmc0: mmc0@20100000 {
		compatible = "anyka,ak3918ev200-mmc0", "anyka,ak39ev330-mmc0";
		reg = <0x20100000 0x7fff>;
		interrupts = <4 0>, <22 0>;
		clocks = <&gclk_asic 0>;
		pinctrl-names = "default";
		pinctrl-0 = <&mci0_pins>;
		bus-width = <1>;
		max-frequency = <25000000>;
		non-removable;
		broken-cd;
		status = "okay";
	};
```

## arch/arm/configs/ak3918en080_v200_defconfig
```kconfig
# CONFIG_ARM_PATCH_PHYS_VIRT is not set
CONFIG_PHYS_OFFSET=0x81800000
CONFIG_EXPERIMENTAL=y
# CONFIG_LOCALVERSION_AUTO is not set
CONFIG_KERNEL_XZ=y
# CONFIG_SWAP is not set
CONFIG_SYSVIPC=y
CONFIG_LOG_BUF_SHIFT=16
CONFIG_CC_OPTIMIZE_FOR_SIZE=y
CONFIG_SYSCTL_SYSCALL=y
CONFIG_EMBEDDED=y
# CONFIG_VM_EVENT_COUNTERS is not set
# CONFIG_SLUB_DEBUG is not set
CONFIG_JUMP_LABEL=y
CONFIG_MODULES=y
CONFIG_MODULE_FORCE_LOAD=y
CONFIG_MODULE_UNLOAD=y
# CONFIG_LBDAF is not set
# CONFIG_BLK_DEV_BSG is not set
# CONFIG_IOSCHED_DEADLINE is not set
CONFIG_ARCH_AK39=y
CONFIG_ARCH_AK3918EN080_V200=y
CONFIG_ASIC_FREQ_VALUE=100000000
CONFIG_AK39_PWM_TIMER=y
# CONFIG_ARM_THUMB is not set
CONFIG_AEABI=y
CONFIG_ARM_FLUSH_CONSOLE_ON_RESTART=y
CONFIG_ZBOOT_ROM_TEXT=0x0
CONFIG_ZBOOT_ROM_BSS=0x0
CONFIG_KEXEC=y
CONFIG_VIDEO_RESERVED_MEM_SIZE=0x1800000
CONFIG_NET=y
CONFIG_PACKET=y
CONFIG_UNIX=y
CONFIG_UNIX_DIAG=y
CONFIG_INET=y
CONFIG_IP_MULTICAST=y
CONFIG_IP_PNP=y
CONFIG_IP_PNP_DHCP=y
CONFIG_IP_PNP_BOOTP=y
CONFIG_IP_PNP_RARP=y
# CONFIG_INET_XFRM_MODE_TRANSPORT is not set
# CONFIG_INET_XFRM_MODE_TUNNEL is not set
# CONFIG_INET_XFRM_MODE_BEET is not set
CONFIG_INET_UDP_DIAG=y
# CONFIG_IPV6 is not set
CONFIG_CFG80211=y
CONFIG_WIRELESS_EXT_SYSFS=y
CONFIG_LIB80211=y
CONFIG_CFG80211_ALLOW_RECONNECT=y
CONFIG_MAC80211=y
CONFIG_RFKILL=y
CONFIG_UEVENT_HELPER_PATH="/sbin/hotplug"
CONFIG_DEVTMPFS=y
CONFIG_DEVTMPFS_MOUNT=y
CONFIG_MTD=y
CONFIG_MTD_CHAR=y
CONFIG_MTD_BLOCK=y
CONFIG_MTD_AK_SPIFLASH=y
CONFIG_BLK_DEV_LOOP=y
CONFIG_AK_MOTOR=y
CONFIG_AK_ISP_CHAR=y
CONFIG_GPIOS_AKCUSTOM=y
CONFIG_NETDEVICES=y
# CONFIG_NET_VENDOR_BROADCOM is not set
# CONFIG_NET_VENDOR_CHELSIO is not set
# CONFIG_NET_VENDOR_CIRRUS is not set
# CONFIG_NET_VENDOR_FARADAY is not set
# CONFIG_NET_VENDOR_INTEL is not set
# CONFIG_NET_VENDOR_MARVELL is not set
# CONFIG_NET_VENDOR_MICREL is not set
# CONFIG_NET_VENDOR_NATSEMI is not set
# CONFIG_NET_VENDOR_SMSC is not set
# CONFIG_NET_VENDOR_STMICRO is not set
# CONFIG_INPUT_MOUSEDEV is not set
CONFIG_INPUT_EVDEV=y
# CONFIG_KEYBOARD_ATKBD is not set
CONFIG_KEYBOARD_AKKEY=y
# CONFIG_INPUT_MOUSE is not set
# CONFIG_SERIO is not set
# CONFIG_VT is not set
CONFIG_DEVPTS_MULTIPLE_INSTANCES=y
CONFIG_LEGACY_PTY_COUNT=10
# CONFIG_DEVKMEM is not set
CONFIG_SERIAL_AK39_UART=y
CONFIG_SERIAL_AK39_CONSOLE=y
CONFIG_TTY_PRINTK=y
# CONFIG_HW_RANDOM is not set
CONFIG_I2C=y
CONFIG_I2C_CHARDEV=y
# CONFIG_I2C_HELPER_AUTO is not set
CONFIG_I2C_SMBUS=y
CONFIG_I2C_ALGOBIT=y
CONFIG_I2C_ANYKA=y
CONFIG_SPI=y
CONFIG_SPI_ANYKA=y
CONFIG_POWER_SUPPLY=y
# CONFIG_HWMON is not set
CONFIG_WATCHDOG=y
CONFIG_WATCHDOG_CORE=y
CONFIG_AK39_WATCHDOG_TOP=y
CONFIG_MEDIA_SUPPORT=y
CONFIG_VIDEO_DEV=y
# CONFIG_RC_CORE is not set
# CONFIG_MEDIA_TUNER_SIMPLE is not set
# CONFIG_MEDIA_TUNER_TDA8290 is not set
# CONFIG_MEDIA_TUNER_TDA827X is not set
# CONFIG_MEDIA_TUNER_TDA18271 is not set
# CONFIG_MEDIA_TUNER_TDA9887 is not set
# CONFIG_MEDIA_TUNER_TEA5761 is not set
# CONFIG_MEDIA_TUNER_TEA5767 is not set
# CONFIG_MEDIA_TUNER_MT20XX is not set
# CONFIG_MEDIA_TUNER_XC2028 is not set
# CONFIG_MEDIA_TUNER_XC5000 is not set
# CONFIG_MEDIA_TUNER_XC4000 is not set
# CONFIG_MEDIA_TUNER_MC44S803 is not set
# CONFIG_MEDIA_TUNER_MAX2165 is not set
# CONFIG_MEDIA_TUNER_TDA18218 is not set
# CONFIG_MEDIA_TUNER_TDA18212 is not set
# CONFIG_V4L_USB_DRIVERS is not set
CONFIG_V4L_PLATFORM_DRIVERS=y
CONFIG_SOC_CAMERA=y
CONFIG_AK_ISP_CORE=y
CONFIG_SENSOR_GC1084=y
CONFIG_VIDEO_AK=y
# CONFIG_RADIO_ADAPTERS is not set
CONFIG_ION=y
CONFIG_ION_AK=y
CONFIG_SOUND=y
CONFIG_SND=y
# CONFIG_SND_SUPPORT_OLD_API is not set
# CONFIG_SND_VERBOSE_PROCFS is not set
# CONFIG_SND_DRIVERS is not set
CONFIG_SND_AK_PCM=y
CONFIG_SUPPORT_AEC=y
# CONFIG_SND_SPI is not set
# CONFIG_SND_USB is not set
# CONFIG_HID_SUPPORT is not set
CONFIG_USB=y
CONFIG_USB_ANNOUNCE_NEW_DEVICES=y
# CONFIG_USB_DEVICE_CLASS is not set
CONFIG_USB_ANYKA_HCD=y
CONFIG_USB_AKOTG_HS_HCD=m
CONFIG_MMC=y
# CONFIG_MMC_BLOCK_BOUNCE is not set
CONFIG_MMC_ANYKA=y
CONFIG_NEW_LEDS=y
CONFIG_LEDS_CLASS=y
CONFIG_LEDS_AK39=y
CONFIG_LEDS_TRIGGERS=y
CONFIG_LEDS_TRIGGER_TIMER=y
CONFIG_RTC_CLASS=y
CONFIG_UIO=y
CONFIG_UIO_VCODEC=y
# CONFIG_IOMMU_SUPPORT is not set
CONFIG_EXT2_FS=y
CONFIG_MSDOS_FS=y
CONFIG_VFAT_FS=y
CONFIG_TMPFS=y
CONFIG_JFFS2_FS=y
# CONFIG_JFFS2_FS_WRITEBUFFER is not set
CONFIG_JFFS2_FS_XATTR=y
# CONFIG_JFFS2_FS_POSIX_ACL is not set
# CONFIG_JFFS2_FS_SECURITY is not set
CONFIG_JFFS2_COMPRESSION_OPTIONS=y
# CONFIG_JFFS2_ZLIB is not set
# CONFIG_JFFS2_RTIME is not set
CONFIG_JFFS2_CMODE_NONE=y
CONFIG_SQUASHFS=y
CONFIG_SQUASHFS_XZ=y
# CONFIG_NETWORK_FILESYSTEMS is not set
CONFIG_NLS_CODEPAGE_437=y
CONFIG_NLS_ISO8859_1=y
CONFIG_NLS_UTF8=y
# CONFIG_SCHED_DEBUG is not set
# CONFIG_STACKTRACE is not set
# CONFIG_DEBUG_BUGVERBOSE is not set
# CONFIG_FTRACE is not set
# CONFIG_ARM_UNWIND is not set
CONFIG_DEBUG_USER=y
# CONFIG_CRYPTO_ANSI_CPRNG is not set
# CONFIG_CRYPTO_HW is not set
# CONFIG_XZ_DEC_X86 is not set
# CONFIG_XZ_DEC_POWERPC is not set
# CONFIG_XZ_DEC_IA64 is not set
# CONFIG_XZ_DEC_SPARC is not set
```

## arch/arm/mach-ak39/Kconfig
```kconfig
# linux/arch/arm/mach-ak39/Kconfig
#
# Copyright 2013 Anaka Microelectronics
#
# Licensed under GPLv2
 
# define CPU TYPE FLAGS 
config CPU_AK3910
	bool
config CPU_AK3916
	bool
config CPU_AK3918
	bool

# aisc cpufreq set
config ASIC_FREQ_VALUE
	int "Config asic frequency(if asic>100MHz asic=vclk; else asic=vclk/2)"
	range 45000000 120000000
	default 90000000
	depends on ARCH_AK39
	help
	  config ak39xx asic frequency when the kernel uncompress.
	  note: vclk be equal to even asic.
```

## arch/arm/mach-anycloud/Kconfig
```kconfig
# linux/arch/arm/mach-anycloud/Kconfig
#
# Copyright 2018 Anyka Microelectronics
#
# Licensed under GPLv2

# Machine support

config MACH_AK39EV330
	bool "anycloudv500 ak39ev330 support"
	depends on ARCH_AK
	help
	  Support for ak39ev330

config MACH_AK3918EV200
	bool "AK3918EV200 support"
	depends on ARCH_AK
	help
	  Support for the AK3918EV200 SoC variant.

config CPU_AK3918EV200
	bool
	default y if MACH_AK3918EV200
	help
	  Selects the AK3918EV200 variants of the ISP2 register layout, the
	  ISP attribute structures and the frame-buffer enable sequence.
	  Set by MACH_AK3918EV200; not user-selectable.
```

## drivers/gpu/ion/Kconfig
```kconfig
menuconfig ION
	tristate "Ion Memory Manager"
	select GENERIC_ALLOCATOR
	select DMA_SHARED_BUFFER
	help
	  Chose this option to enable the ION Memory Manager.

config ION_AK
	tristate "Ion for AK"
	depends on ION
	help
	  Choose this option if you wish to use ion on an AK platform.
```

## drivers/media/platform/anyka/Kconfig
```kconfig
config VIDEO_AK_VENC
	tristate "Anyka AK3918EV200 H.264 encoder"
	depends on VIDEO_DEV && VIDEO_V4L2 && ARCH_AK
	select VIDEOBUF2_DMA_CONTIG
	select V4L2_MEM2MEM_DEV
	help
	  V4L2 mem2mem driver for the Hantro/On2 8290 video encoder in the
	  AK3918EV200. OUTPUT takes raw I420 frames, CAPTURE produces H.264
	  or JFIF JPEG.

	  This driver and the UIO codec driver both own the same register
	  file; run one or the other.

	  To compile this driver as a module, choose M here: the module will
	  be called ak_venc.

config VIDEO_AK_CAM
	bool "Anyka AK3918EV200 V4L2 capture bridge"
	depends on VIDEO_DEV && VIDEO_V4L2 && ARCH_AK && AK_ISP_CHAR
	depends on !VIDEO_AK
	select VIDEOBUF2_CORE
	select VIDEOBUF2_DMA_CONTIG
	help
	  Plain V4L2 capture driver for the ISP2 video output, replacing the
	  soc_camera host in drivers/media/platform/soc_camera/plat-anyka/
	  ak_camera.c. It registers two capture nodes, main and sub channel,
	  over videobuf2 with MMAP and USERPTR.

	  This driver and VIDEO_AK claim the same device tree node
	  ("anyka,ak39ev330-isp"); only one can be built.

	  If unsure, say N.

config VIDEO_AK_CAM_SENSOR
	bool "Anyka sensor subdev for the capture bridge"
	depends on VIDEO_AK_CAM
	help
	  The "aksensor" i2c client as a v4l2_subdev with .s_power and a control
	  handler, wrapping the AK_ISP_SENSOR_CB registry. It replaces
	  drivers/media/platform/soc_camera/plat-anyka/ak_sensor.c, which needs
	  soc_camera.

	  Say N to keep the soc_camera-era sensor glue while the bridge itself
	  is brought up.

	  If unsure, say N.
```

## drivers/media/platform/soc_camera/Kconfig
```kconfig
config SOC_CAMERA
	tristate "SoC camera support"
	depends on VIDEO_V4L2 && HAS_DMA && I2C
	select VIDEOBUF_GEN
	select VIDEOBUF2_CORE
	help
	  SoC Camera is a common API to several cameras, not connecting
	  over a bus like PCI or USB. For example some i2c camera connected
	  directly to the data bus of an SoC.

config SOC_CAMERA_SCALE_CROP
	tristate

config SOC_CAMERA_PLATFORM
	tristate "platform camera support"
	depends on SOC_CAMERA
	help
	  This is a generic SoC camera platform driver, useful for testing

config VIDEO_MX3
	tristate "i.MX3x Camera Sensor Interface driver"
	depends on VIDEO_DEV && MX3_IPU && SOC_CAMERA
	depends on MX3_IPU || COMPILE_TEST
	depends on HAS_DMA
	select VIDEOBUF2_DMA_CONTIG
	---help---
	  This is a v4l2 driver for the i.MX3x Camera Sensor Interface

config VIDEO_PXA27x
	tristate "PXA27x Quick Capture Interface driver"
	depends on VIDEO_DEV && PXA27x && SOC_CAMERA
	select VIDEOBUF_DMA_SG
	---help---
	  This is a v4l2 driver for the PXA27x Quick Capture Interface

config VIDEO_RCAR_VIN
	tristate "R-Car Video Input (VIN) support"
	depends on VIDEO_DEV && SOC_CAMERA
	depends on ARCH_SHMOBILE || COMPILE_TEST
	depends on HAS_DMA
	select VIDEOBUF2_DMA_CONTIG
	select SOC_CAMERA_SCALE_CROP
	---help---
	  This is a v4l2 driver for the R-Car VIN Interface

config VIDEO_SH_MOBILE_CSI2
	tristate "SuperH Mobile MIPI CSI-2 Interface driver"
	depends on VIDEO_DEV && SOC_CAMERA && HAVE_CLK
	depends on ARCH_SHMOBILE || SUPERH || COMPILE_TEST
	---help---
	  This is a v4l2 driver for the SuperH MIPI CSI-2 Interface

config VIDEO_SH_MOBILE_CEU
	tristate "SuperH Mobile CEU Interface driver"
	depends on VIDEO_DEV && SOC_CAMERA && HAS_DMA && HAVE_CLK
	depends on ARCH_SHMOBILE || SUPERH || COMPILE_TEST
	depends on HAS_DMA
	select VIDEOBUF2_DMA_CONTIG
	select SOC_CAMERA_SCALE_CROP
	---help---
	  This is a v4l2 driver for the SuperH Mobile CEU Interface

config VIDEO_OMAP1
	tristate "OMAP1 Camera Interface driver"
	depends on VIDEO_DEV && SOC_CAMERA
	depends on ARCH_OMAP1
	depends on HAS_DMA
	select VIDEOBUF_DMA_CONTIG
	select VIDEOBUF_DMA_SG
	---help---
	  This is a v4l2 driver for the TI OMAP1 camera interface

config VIDEO_MX2
	tristate "i.MX27 Camera Sensor Interface driver"
	depends on VIDEO_DEV && SOC_CAMERA
	depends on SOC_IMX27 || COMPILE_TEST
	depends on HAS_DMA
	select VIDEOBUF2_DMA_CONTIG
	---help---
	  This is a v4l2 driver for the i.MX27 Camera Sensor Interface

config VIDEO_ATMEL_ISI
	tristate "ATMEL Image Sensor Interface (ISI) support"
	depends on VIDEO_DEV && SOC_CAMERA
	depends on ARCH_AT91 || COMPILE_TEST
	depends on HAS_DMA
	select VIDEOBUF2_DMA_CONTIG
	---help---
	  This module makes the ATMEL Image Sensor Interface available
	  as a v4l2 device.

config VIDEO_AK
	tristate "AK Camera Interface driver"
	depends on VIDEO_DEV && SOC_CAMERA && AK_ISP_CHAR
	select VIDEOBUF_DMA_CONTIG
	---help---
	  This is a v4l2 driver for the AK Platform Camera Interface. It uses
	  the ISP2 interface provided by AK_ISP_CHAR.

config AK_ISP_CORE
	bool "Anyka ISP core, built from source"
	depends on ARCH_AK
	help
	  The ak_isp_* implementation behind /dev/isp_char.

	  If unsure, say N.

config SENSOR_GC1084
	bool "GalaxyCore GC1084 sensor support (DVP)"
	depends on AK_ISP_CHAR
	help
	  GC1084 on a DVP bus, 1280x720 at 30fps.

	  If unsure, say N.

config LINUX_AKSENSOR
	tristate "Anyka legacy sensor stack (aksensor)"
	depends on SOC_CAMERA && I2C
	help
	  A board-info-registered SCCB/I2C sensor stack (aksensor.c/
	  wrap_sensor.c) and its camera_*.c client drivers below.

	  If unsure, say N.

config SENSOR_GC0308
	tristate "gc0308 sensor support"
	depends on LINUX_AKSENSOR
	help
	  This is a gc0308 sensor driver

config SENSOR_OV2643
	tristate "ov2643 sensor support"
	depends on LINUX_AKSENSOR
	help
	  This is a ov2643 sensor driver

config SENSOR_OV7725
	tristate "ov7725 sensor support"
	depends on LINUX_AKSENSOR
	help
	  This is a ov7725 sensor driver

config SENSOR_HM1375
	tristate "hm1375 sensor support"
	depends on LINUX_AKSENSOR
	help
	  This is a hm1375 sensor driver

config SENSOR_OV9712
	tristate "ov9712 sensor support"
	depends on LINUX_AKSENSOR
	help
	  This is a ov9712 sensor driver

config SENSOR_OV2710
	tristate "ov2710 sensor support"
	depends on LINUX_AKSENSOR
	help
	  This is a ov2710 sensor driver

config SENSOR_AR0130
	tristate "ar0130 sensor support"
	depends on LINUX_AKSENSOR
	help
	  This is a ar0130 sensor driver

config SENSOR_H22
	tristate "jx-h22 sensor support"
	depends on LINUX_AKSENSOR
	help
	  This is a jx-h22 sensor driver

config SENSOR_NT99141
	tristate "nt99141 sensor support"
	depends on LINUX_AKSENSOR
	help
	  This is a nt99141 sensor driver
```
